#include <avr/io.h>


int main(void)
{
	DDRD = 0b11111111; // обозначаем все порты на выход
	PORTD = 0b00000000;    // высокое входное напряжение
	
	DDRB = (0 << 0) | (0 << 1);	// инициализируем кнопку
	PORTB = (1 << 0) | (1 << 1);

	TCCR0 |= (1 << CS00) | (1 << CS02) ;    // включаем таймер с предделителем частоты 1024
    TCNT0 = 0;	// сбрасываем таймер в ноль 
	
	int a = 0;	// переменная для сложения значений таймера
	
	while(1)
	{
		if (~PINB & (1 << 0))
		{
			
			if(TCNT0 == 100)
			{
				a++;
				TCNT0 = 0;
			}
			if (a == 6)
			{
				PORTD = 0b10101010;
			}
			if (a == 12)
			{
				PORTD = 0b01010101;
			}
			if (a >= 18)
			{
				a = 0;
			}
		}
		if (~PINB & (1 << 1))
		{
			PORTD = 0b00000000;
		}
	}
}



