#define F_CPU 1000000UL // принудительно объявляем, что частота МК = 1Мгц
#include <avr/io.h>
#include <util/delay.h> // подключаем библиотеку задерки времени
#define sec 200 // определяем значение времени
#define LEDS_D PORTD    // назовем порт D для светодиодов
#define LEDS_B PORTB    // назовем порт B для светодиодов
#define BUTTON PORTC    // назовем порт С для кнопок 


int ports_on[] = {0b00000001,0b00000010,   // обозначим пины МК для вкл 
                0b00000100,0b00001000,
                0b00010000,0b00100000,
                0b01000000,0b10000000};
				
int ports_off[] = {0b00000000,0b00000001,   // обозначим пины МК для выкл
                0b00000011,0b00000111,
                0b00001111,0b00011111,
                0b00111111,0b01111111};

int main(void)
{
    DDRD = 0b11111111;  // светодиоды. настроили порт навыход
    DDRB = 0b00000000;  // кнопки. настроили порты на входы
    PORTD = 0b00000000; // светодиод. подали на порты низкий уровень сигнала
    PORTB = 0b11111111; // кнопка. подали на порты высокий уровень сигнала
    
    while (1)
    {
        if (PINB == 0b11111110)	// если первая кнопка нажата
        {
            PORTD = 0b11111111;	// подаем высокий уровень сигнала на выходы 
            _delay_ms(sec);		// задержка
            PORTD = 0b00000000;	// подаем назкий уровень сигнала на выходы
            _delay_ms(sec);		// задержка
        }
		else if (PINB == 0b11111101)	// если вторая кнопка нажата
		{
			for (int i = 0; i <= 8; i++)	// запускаем цикл 
			{
				PORTD |= ports_on[i];	// подаем высокий сигнал на порты по очереди
				_delay_ms(sec);
				if (PORTD == 0b11111111)	// если на всех портах высокий уровень сигнала
				{
					for (int y = 7; y >= 0; y--)   // запускаем обратный цикл
					{
						PORTD = ports_off[y]; // достаем значения из второго массива
						_delay_ms(sec);   // задержка
					}
				}
			}
		} 
		else					// если ни одна кнопка не нажата
		{	
			PORTD = 0b00000000;	// подаем низкий уровень сигнала на выходы
		}
		
    }
}

